## config/west.yml
```yaml
# This file specifies the build dependencies for Github Action workflows and
# for local build environments. The workspace has three toplevel directories
# containing the user config, user modules and ZMK. Zephyr and its dependencies
# are namespaced under /zmk to keep the toplevel clean.
#
# ZMK-Workspace
# ├── config
# ├── modules (user modules)
# └── zmk
#     └── modules (Zephyr modules)
#
# To create a local build environment, clone this repository and then run the
# following commands from its toplevel directory:
#
# $ west init -l config
# $ west update
# $ west zephyr-export
#
---
manifest:
  defaults:
    remote: urob
    revision: v0.1 # Pin everything to v0.1

  remotes:
    - name: urob
      url-base: https://github.com/urob
    - name: zmkfirmware
      url-base: https://github.com/zmkfirmware

  projects:
    # This is vanilla ZMK - just using my remote to pin the current state of main,
    # as upstream hasn't yet released a version with mouse.
    - name: zmk
      revision: v0.1+mouse
      import: app/west.yml

    # ZMK modules
    - name: zmk-adaptive-key
      path: modules/zmk/adaptive-key
    - name: zmk-auto-layer
      path: modules/zmk/auto-layer
    - name: zmk-helpers
      path: modules/zmk/helpers
    - name: zmk-leader-key
      revision: v0.1+locality
      path: modules/zmk/leader-key
    - name: zmk-tri-state
      path: modules/zmk/tri-state

    # Temporarily overload Zephyr until
    # https://github.com/zmkfirmware/zephyr/pull/40 is merged.
    - name: zephyr
      revision: v3.5.0+zmk-fixes
      clone-depth: 1
      import:
        file: app/west.yml
        path-prefix: zmk

  self:
    path: config
```
